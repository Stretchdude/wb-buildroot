## configs/ctcgate_defconfig
```kconfig
BR2_arm=y
BR2_cortex_a5=y
BR2_ARM_ENABLE_VFP=y
BR2_ARM_INSTRUCTIONS_THUMB2=y
BR2_WGET="wget --passive-ftp -nd"
BR2_DL_DIR="$(HOME)/.br2_dl_dir"
BR2_CCACHE=y
BR2_CCACHE_DIR="$(BR2_DL_DIR)/.buildroot-ccache"
BR2_OPTIMIZE_3=y
BR2_PACKAGE_OVERRIDE_FILE="$(TOPDIR)/board/laird/som60/som60-local.mk"
BR2_TOOLCHAIN_EXTERNAL=y
BR2_TOOLCHAIN_EXTERNAL_LAIRD_ARM=y
BR2_TARGET_GENERIC_HOSTNAME="lairdgate"
BR2_TARGET_GENERIC_ISSUE="Laird Connectivity"
BR2_ROOTFS_DEVICE_CREATION_DYNAMIC_EUDEV=y
BR2_ROOTFS_DEVICE_TABLE="board/laird/device_table.txt"
BR2_TARGET_GENERIC_ROOT_PASSWD="beris"
BR2_SYSTEM_BIN_SH_BASH=y
BR2_ENABLE_LOCALE_WHITELIST="en_US"
BR2_ROOTFS_POST_BUILD_SCRIPT="board/laird/som60/post_build.sh"
BR2_ROOTFS_POST_IMAGE_SCRIPT="board/laird/som60/post_image.sh"
BR2_ROOTFS_POST_SCRIPT_ARGS="som60x2sd board/laird/configs-common/keys"
BR2_LINUX_KERNEL=y
BR2_LINUX_KERNEL_DEFCONFIG="ig60ll"
BR2_LINUX_KERNEL_IMAGE_TARGET_CUSTOM=y
BR2_LINUX_KERNEL_IMAGE_TARGET_NAME="Image"
BR2_LINUX_KERNEL_DTS_SUPPORT=y
BR2_LINUX_KERNEL_INTREE_DTS_NAME="at91-ig60ll"
BR2_PACKAGE_BUSYBOX_CONFIG="$(TOPDIR)/package/ctcfiles/busybox.config"
BR2_PACKAGE_BUSYBOX_SHOW_OTHERS=y
BR2_PACKAGE_GDB=y
BR2_PACKAGE_NETPERF=y
BR2_PACKAGE_STRACE=y
BR2_PACKAGE_TRACE_CMD=y
BR2_PACKAGE_WHETSTONE=y
BR2_PACKAGE_MTD=y
BR2_PACKAGE_LINUXCONSOLETOOLS=y
BR2_PACKAGE_MEMTESTER=y
BR2_PACKAGE_OFONO=y
BR2_PACKAGE_PICOCOM=y
BR2_PACKAGE_SETSERIAL=y
BR2_PACKAGE_UBOOT_TOOLS=y
BR2_PACKAGE_PYTHON_LIBCONFIG=y
BR2_PACKAGE_PYTHON_PATHTOOLS=y
BR2_PACKAGE_PYTHON_PSUTIL=y
BR2_PACKAGE_PYTHON_SERIAL=y
BR2_PACKAGE_LZO=y
BR2_PACKAGE_CA_CERTIFICATES=y
BR2_PACKAGE_CRYPTODEV=y
BR2_PACKAGE_GNUTLS_OPENSSL=y
BR2_PACKAGE_GNUTLS_TOOLS=y
BR2_PACKAGE_LIBXMLPP=y
BR2_PACKAGE_LOG4CXX=y
BR2_PACKAGE_LIBCURL=y
BR2_PACKAGE_CURL=y
BR2_PACKAGE_RESTCLIENTCPP=y
BR2_PACKAGE_LIBEDIT=y
BR2_PACKAGE_BLUEZ5_UTILS=y
BR2_PACKAGE_BLUEZ5_UTILS_OBEX=y
BR2_PACKAGE_BLUEZ5_UTILS_CLIENT=y
BR2_PACKAGE_BLUEZ5_UTILS_DEPRECATED=y
BR2_PACKAGE_BLUEZ5_UTILS_EXPERIMENTAL=y
BR2_PACKAGE_BLUEZ5_UTILS_TEST=y
BR2_PACKAGE_LIBBLEPP=y
BR2_PACKAGE_BASE64=y
BR2_PACKAGE_BRIDGE_UTILS=y
BR2_PACKAGE_CAN_UTILS=y
BR2_PACKAGE_CHRONY=y
BR2_PACKAGE_CONNTRACK_TOOLS=y
BR2_PACKAGE_DNSMASQ=y
# BR2_PACKAGE_DNSMASQ_TFTP is not set
BR2_PACKAGE_DNSMASQ_DNSSEC=y
BR2_PACKAGE_DROPBEAR=y
BR2_PACKAGE_ETHTOOL=y
BR2_PACKAGE_FIREWALLD=y
# BR2_PACKAGE_IFUPDOWN_SCRIPTS is not set
BR2_PACKAGE_IPERF=y
BR2_PACKAGE_IPERF3=y
BR2_PACKAGE_IPROUTE2=y
BR2_PACKAGE_IW=y
BR2_PACKAGE_MII_DIAG=y
BR2_PACKAGE_NETSTAT_NAT=y
BR2_PACKAGE_PPPD=y
BR2_PACKAGE_SOCAT=y
BR2_PACKAGE_TCPDUMP=y
BR2_PACKAGE_WILGATE=y
BR2_PACKAGE_LOCKFILE_PROGS=y
BR2_PACKAGE_UTIL_LINUX_AGETTY=y
BR2_PACKAGE_UTIL_LINUX_HWCLOCK=y
BR2_PACKAGE_CTCFILES=y
BR2_PACKAGE_LESS=y
BR2_PACKAGE_VIM=y
BR2_TARGET_UBOOT=y
BR2_TARGET_UBOOT_BUILD_SYSTEM_KCONFIG=y
BR2_TARGET_UBOOT_CUSTOM_VERSION=y
BR2_TARGET_UBOOT_CUSTOM_VERSION_VALUE="2018.01"
BR2_TARGET_UBOOT_BOARD_DEFCONFIG="ig60llsd"
BR2_TARGET_UBOOT_NEEDS_DTC=y
# BR2_TARGET_UBOOT_FORMAT_BIN is not set
BR2_TARGET_UBOOT_FORMAT_CUSTOM=y
BR2_TARGET_UBOOT_FORMAT_CUSTOM_NAME="u-boot.dtb u-boot-nodtb.bin"
BR2_TARGET_UBOOT_SPL=y
BR2_TARGET_UBOOT_SPL_NAME="spl/u-boot-spl-nodtb.bin spl/u-boot-spl.dtb"
BR2_PACKAGE_HOST_CRYPTSETUP=y
BR2_PACKAGE_HOST_E2FSPROGS=y
BR2_PACKAGE_HOST_MTD=y
BR2_PACKAGE_HOST_UBOOT_TOOLS=y
BR2_PACKAGE_HOST_UBOOT_TOOLS_FIT_SUPPORT=y
BR2_PACKAGE_HOST_UBOOT_TOOLS_FIT_SIGNATURE_SUPPORT=y
BR2_LRD_SOM60_RADIO=y
BR2_PACKAGE_MC_MINT=y
BR2_PACKAGE_LRD_NETWORK_MANAGER_MODEM_MANAGER=y
BR2_PACKAGE_LRD_AUTOMOUNT=y
# BR2_PACKAGE_LRD_AUTOMOUNT_MMC is not set
BR2_PACKAGE_LRD_BT_UTILS=y
BR2_PACKAGE_IGUPD=y
```

## package/base64/Config.in
```kconfig
config BR2_PACKAGE_BASE64
       bool "base64"
       help
               base 64 lib in a header - staging only
               https://github.com/tkislan/base64 but
               here is used: https://github.com/Stretchdude/base64
```

## package/libblepp/Config.in
```kconfig
config BR2_PACKAGE_LIBBLEPP
       bool "libblepp"
       help
               libble++ bluetooth for c++ -  a c++-only (no dbus) ble interface as library
```

## package/restclientcpp/Config.in
```kconfig
config BR2_PACKAGE_RESTCLIENTCPP
       bool "restclientcpp"
       help
               static lib to allow easy rest api access as client
```
